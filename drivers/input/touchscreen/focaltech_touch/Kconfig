## drivers/input/touchscreen/focaltech_touch/Kconfig
```kconfig
config TOUCHSCREEN_FOCALTECH
	tristate "FocalTech Touchscreen Driver"
	depends on I2C
	help
	  Say Y here if you have a FocalTech touchscreen.
```

## drivers/input/touchscreen/gslx680/Kconfig
```kconfig
config TOUCHSCREEN_GSLX680
	tristate "Silead GSLX680 Touchscreen Driver"
	depends on I2C
	help
	  Say Y here if you have a Silead GSLX680 touchscreen.
```

## drivers/input/touchscreen/gt9xx/Kconfig
```kconfig
config TOUCHSCREEN_GT9XX
	tristate "Goodix GT9xx Touchscreen Driver"
	depends on I2C
	help
	  Say Y here if you have a Goodix GT9xx touchscreen.
```
